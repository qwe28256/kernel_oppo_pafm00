## drivers/misc/oppo/Kconfig
```kconfig
menuconfig OPPO_MOTOR
	bool "OPPO motor control system"
	depends on I2C
	select REGMAP_I2C
	help
	  Say Y here to enable OPPO motor control system support

if OPPO_MOTOR

config CAMERA_MOTOR_DRV8834
	tristate "CAMERA MOTOR DRV8834 Controler"
	default n
	help
	  Say Y here to enable DRV8834.

config DIGITAL_HALL_M1120
	tristate "digital hall m1120 Controler"
	default n
	help
	  Say Y here to enable m1120.

config MOTOR_CLASS_INTERFACE
	bool "OPPO motor class interface"
	help
	  Say Y here if you want to using motor class interface

endif #OPPO_CHARGER

config OPPO_SIMPLE_ROOT
	bool "OPPO simple in-kernel root (debug only)"
	default n
	help
	  Say Y here to build /dev/opporoot, a minimal debug backdoor that lets
	  a userspace process escalate itself to uid 0 (and switches SELinux to
	  permissive) through a single ioctl.

	  This exists only to give the PAFM00 kernel-porting workflow a root
	  shell without re-patching every test boot image for APatch.  Any
	  process able to open /dev/opporoot becomes root, so never enable this
	  in a kernel you intend to ship.
```
